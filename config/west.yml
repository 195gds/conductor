## config/west.yml
```yaml
manifest:
  remotes:
    - name: zmkfirmware
      url-base: https://github.com/zmkfirmware
    - name: pite1222
      url-base: https://github.com/pite1222
    - name: caksoylar
      url-base: https://github.com/caksoylar
    - name: 4mplelab
      url-base: https://github.com/4mplelab
    - name: aratahorie
      url-base: https://github.com/aratahorie
  projects:
    - name: zmk
      remote: aratahorie
      revision: main
      import:
        file: app/west.yml
        name-blocklist:
          - zmk-studio-messages
    - name: zmk-studio-messages
      remote: aratahorie
      revision: d2034609859e14b0a2c46b55bd5e4dc51ad33da1
      path: modules/msgs/zmk-studio-messages
    - name: zmk-pmw3610-driver
      remote: pite1222
      revision: main
    - name: zmk-rgbled-widget
      remote: pite1222
      revision: critical-steady-light
    - name: zmk-feature-charge-indicator
      remote: 4mplelab
      revision: main
  self:
    path: config
```
